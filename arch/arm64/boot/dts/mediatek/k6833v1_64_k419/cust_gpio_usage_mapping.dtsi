/*
 * Generated by MTK SP DrvGen Version: 3.5.160809 for MT6833.
 * 2023-03-11 17:22:09
 * Do Not Modify The File.
 * Copyright Mediatek Inc. (c) 2016.
*/

&gpio_usage_mapping {
	GPIO_FDD_BAND_SUPPORT_DETECT_1ST_PIN = <&pio 44 0>;
	GPIO_FDD_BAND_SUPPORT_DETECT_2ND_PIN = <&pio 45 0>;
	GPIO_FDD_BAND_SUPPORT_DETECT_3RD_PIN = <&pio 46 0>;
	GPIO_SIM1_HOT_PLUG = <&pio 77 0>;
	GPIO_SIM2_HOT_PLUG = <&pio 78 0>;
	GPIO_SIM2_SCLK = <&pio 119 0>;
	GPIO_SIM2_SRST = <&pio 120 0>;
	GPIO_SIM2_SIO = <&pio 121 0>;
	GPIO_SIM1_SIO = <&pio 122 0>;
	GPIO_SIM1_SRST = <&pio 123 0>;
	GPIO_SIM1_SCLK = <&pio 124 0>;
	GPIO_RF_PWREN_RST_PIN = <&pio 170 0>;
};
